## conf/bblayers.conf.sample
```bitbake
LCONF_VERSION = "7"

BBPATH = "${TOPDIR}"
BBFILES ?= ""

BBLAYERS ?= " \
    ##OEROOT##/meta \
    ##OEROOT##/meta-poky \
    ##OEROOT##/../meta-openembedded/meta-perl \
    ##OEROOT##/../meta-openembedded/meta-python \
    ##OEROOT##/../meta-openembedded/meta-filesystems \
    ##OEROOT##/../meta-openembedded/meta-multimedia \
    ##OEROOT##/../meta-openembedded/meta-networking \
    ##OEROOT##/../meta-openembedded/meta-webserver \
    ##OEROOT##/../meta-openembedded/meta-initramfs \
    ##OEROOT##/../meta-openembedded/meta-oe \
    ##OEROOT##/../meta-qt5 \
    ##OEROOT##/../meta-raspberrypi \
    ##OEROOT##/../meta-homeassistant \
    ##OEROOT##/../meta-java \
    ##OEROOT##/../meta-iot-cloud \
    ##OEROOT##/../meta-cloud-services/meta-openstack \
    ##OEROOT##/../meta-walle \
"

BBLAYERS_NON_REMOVABLE ?= " \
    ##OEROOT##/meta \
"
```

## conf/distro/include/walle-features.conf
```bitbake
IMAGE_FSTYPES += " ext4 fwup-img"

POKY_DEFAULT_DISTRO_FEATURES = "largefile opengl ptest multiarch wayland vulkan"

# BusyBox features
BUSYBOX_FEATURES = " \
	busybox-hd \
	busybox-ftpd \
	busybox-ftp \
	busybox-telnetd \
	busybox-mdev \
	busybox-inetd \
	busybox-httpd \
	"
POKY_DEFAULT_DISTRO_FEATURES_append = " ${BUSYBOX_FEATURES} pam x11 fbdev opengl systemd"


DISTRO_FEATURES_append = " x11 systemd bluez5"
DISTRO_FEATURES_BACKFILL_CONSIDERED += " sysvinit "
VIRTUAL-RUNTIME_init_manager = "systemd"
VIRTUAL-RUNTIME_login_manager = "busybox"
VIRTUAL-RUNTIME_initscripts = "systemd-compat-units"

BINDINGS_pn-mraa = "python nodejs"
BINDINGS_pn-upm = "python nodejs"

UBOOT_SUFFIX = "bin"

LICENSE_FLAGS_WHITELIST = " \
	commercial_${MLPREFIX}ffmpeg \
	commercial_${MLPREFIX}x264 \
	commercial_${MLPREFIX}gstreamer1.0-omx \
	commercial_${MLPREFIX}libomxil \
	commercial_${MLPREFIX}sox"

# Override these in poky based distros
POKY_DEFAULT_EXTRA_RDEPENDS = "packagegroup-core-boot"
POKY_DEFAULT_EXTRA_RRECOMMENDS = "kernel-module-af-packet"

DISTRO_FEATURES ?= "${DISTRO_FEATURES_DEFAULT} ${DISTRO_FEATURES_LIBC} ${POKY_DEFAULT_DISTRO_FEATURES}"
```

## conf/distro/walle.conf
```bitbake
require conf/distro/poky.conf
require conf/distro/include/walle-features.conf

DISTRO = "walle"
DISTRO_NAME = "Wall-E"
DISTRO_VERSION = "2018.04"
SDK_VENDOR = "-walle"
SDK_VERSION := "${@'${DISTRO_VERSION}'.replace('snapshot-${DATE}','snapshot')}"

MAINTAINER = "Linh Nguyen <nvl1109@gmail.com>"

TARGET_VENDOR = "-walle"

SANITY_TESTED_DISTROS_append = " \
	ubuntu-16.04 \n \
	ubuntu-18.04 \n \
	"

# Blacklist packages
INHERIT += "blacklist"
PNBLACKLIST[distro-feed-configs]  = "Not supported, see petalinux-image-common.inc for feed config."

INHERIT += "buildhistory"
BUILDHISTORY_COMMIT = "1"

#INHERIT += "archiver"

COPY_LIC_MANIFEST = "1"
LICENSE_CREATE_PACKAGE = "1"
BB_GENERATE_MIRROR_TARBALLS = "1"

EXTRA_USERS_PARAMS = "usermod -P root root; "
```

## conf/layer.conf
```bitbake
# We have a conf and classes directory, append to BBPATH
BBPATH .= ":${LAYERDIR}"

# We have a recipes directory, add to BBFILES
BBFILES += "${LAYERDIR}/recipes*/*/*.bb ${LAYERDIR}/recipes*/*/*.bbappend ${LAYERDIR}/recipes*/images/*.bb ${LAYERDIR}/classes/*.bbclass"

BBFILE_COLLECTIONS += "meta-walle"
BBFILE_PATTERN_meta-walle := "^${LAYERDIR}/"
BBFILE_PRIORITY_meta-walle = "16"

LAYERSERIES_COMPAT_meta-walle = "thud sumo"
```

## conf/local.conf.sample
```bitbake
# Local configuration for meta-rpi images
# Yocto Project 2.5 Poky distribution [sumo] branch
# This is a sysvinit system

LICENSE_FLAGS_WHITELIST = "commercial"

DISTRO_FEATURES = "ext2 pam opengl usbhost ${DISTRO_FEATURES_LIBC} systemd bluez5 wayland"

DISTRO_FEATURES_BACKFILL_CONSIDERED += "pulseaudio"

PREFERRED_PROVIDER_jpeg = "libjpeg-turbo"
PREFERRED_PROVIDER_jpeg-native = "libjpeg-turbo-native"

PREFERRED_PROVIDER_udev = "eudev"

MACHINE_FEATURES_remove = "apm"

IMAGE_FSTYPES = "tar ext4 fwup-img"

# override the meta-raspberrypi default 4.9 kernel
PREFERRED_VERSION_linux-raspberrypi = "4.14.%"

# Choose the board you are building for
MACHINE = "walle-pi3"

# Choices are Image or zImage if NOT using u-boot (no u-boot is the default)
# Choices are uImage or zImage if using u-boot, though if you choose zImage
# with u-boot you will also have to change the boot script boot command
KERNEL_IMAGETYPE = "zImage"

ENABLE_UART="1"

DL_DIR = "${HOME}/downloads"

SSTATE_DIR = "${HOME}/sstate"

#TMPDIR = "/oe4/rpi/tmp-sumo"

DISTRO ?= "walle"

PACKAGE_CLASSES = "package_ipk"

# i686 or x86_64
SDKMACHINE = "x86_64"

#EXTRA_IMAGE_FEATURES = "debug-tweaks"
INHERIT += "extrausers"
EXTRA_USERS_PARAMS = "usermod -P root root; useradd -m -s /bin/bash -G root,dialout,bin,tty,disk,sudo,audio,video,shutdown,users,sshd walle; usermod -P walle walle;"

USER_CLASSES = "image-mklibs image-prelink"

PATCHRESOLVE = "noop"

RM_OLD_IMAGE = "1"

INHERIT += "rm_work"

CONF_VERSION = "1"

DISTRO_FEATURES_append = " systemd"
VIRTUAL-RUNTIME_init_manager = "systemd"
DISTRO_FEATURES_BACKFILL_CONSIDERED = "sysvinit"
VIRTUAL-RUNTIME_initscripts = ""

WALLE_FW_PLATFORM ?= "walle"
WALLE_FW_VERSION ?= "0.2.1"
# Network type: dhcp/static/off
WALLE_FW_ETH0_TYPE ?= "dhcp"
WALLE_FW_ETH0_IP ?= "10.71.4.104"
WALLE_FW_ETH0_GW ?= "10.71.4.1"
WALLE_FW_ETH0_DNS ?= "10.100.1.2"

IMAGE_INSTALL += " wayland"
```

## conf/machine/include/rpi-default-settings.inc
```bitbake
# RaspberryPi BSP default settings

IMAGE_CLASSES += "fwup-image"
IMAGE_TYPES += " ext4 fwup-img"
```

## conf/machine/walle-pi3.conf
```bitbake
DEFAULTTUNE ?= "cortexa7thf-neon-vfpv4"
require conf/machine/include/tune-cortexa7.inc
include conf/machine/include/walle-base.inc

MACHINE_EXTRA_RRECOMMENDS += "\
    linux-firmware-bcm43430 \
    linux-firmware-bcm43455 \
    linux-firmware-bcm43430a1-hcd \
    linux-firmware-bcm4345c0-hcd \
"

SDIMG_KERNELIMAGE ?= "kernel.img"
UBOOT_MACHINE = "rpi_3_32b_config"
SERIAL_CONSOLE ?= "115200 ttyS0"
VC4_CMA_SIZE ?= "cma-256"

KERNEL_IMAGETYPE_DIRECT ?= "zImage"

IMAGE_TYPES += "fwup-img"
IMAGE_CLASSES += "fwup-image"

# Enable waveshare LCD
WAVESHARE_1024X600_C_2_1 = "1"
```
